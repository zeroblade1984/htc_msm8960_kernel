## arch/arm/mach-msm/boards/Kconfig
```kconfig
config MACH_HTC
	bool

menu "HTC Board Selection"
source "arch/arm/mach-msm/boards/Kconfig.board"
endmenu
```

## arch/arm/mach-msm/boards/Kconfig.board
```kconfig
#
# Include the specific Kconfig file for HTC board
#

# DLXU
source "arch/arm/mach-msm/boards/board-dlxu/Kconfig"

# DLXUB1
source "arch/arm/mach-msm/boards/board-dlxub1/Kconfig"

# DLX
source "arch/arm/mach-msm/boards/board-monarudo/Kconfig"
```

## arch/arm/mach-msm/boards/board-dlxpul/Kconfig
```kconfig
config MACH_DLXP_UL
	depends on ARCH_APQ8064
	bool "APQ8064 DLXP_UL"
	help
	  Support for the HTC APQ8064 DLXP_UL.

config MACH_DLXP_U
	depends on ARCH_APQ8064
	bool "APQ8064 DLXP_U"
	help
	  Support for the HTC APQ8064 DLXP_U.
```

## arch/arm/mach-msm/boards/board-dlxu/Kconfig
```kconfig
config MACH_DELUXE_U
        depends on ARCH_APQ8064
        bool "APQ8064 DELUXE_U"
        help
          Support for the HTC APQ8064 DELUXE_U.

config MACH_DELUXE_UL
        depends on ARCH_APQ8064
        bool "APQ8064 DELUXE_UL"
        help
          Support for the HTC APQ8064 DELUXE_UL.
```

## arch/arm/mach-msm/boards/board-dlxub1/Kconfig
```kconfig
config MACH_DELUXE_UB1
        depends on ARCH_APQ8064
        bool "APQ8064 DELUXE_UB1"
        help
          Support for the HTC APQ8064 DELUXE_UB1.
```

## arch/arm/mach-msm/boards/board-m7/Kconfig
```kconfig
config MACH_M7_UL
        depends on ARCH_APQ8064
        bool "APQ8064 M7_UL"
        help
          Support for the HTC APQ8064 M7_UL.

config MACH_M7_U
        depends on ARCH_APQ8064
        bool "APQ8064 M7_U"
        help
          Support for the HTC APQ8064 M7_U.

config MACH_M7_WLS
        depends on ARCH_APQ8064
        bool "APQ8064 M7_WLS"
        help
          Support for the HTC APQ8064 M7_WLS.

config MACH_M7_WLV
        depends on ARCH_APQ8064
        bool "APQ8064 M7_WLV"
        help
          Support for the HTC APQ8064 M7_WLV.

config MACH_M7_WLJ
        depends on ARCH_APQ8064
        bool "APQ8064 M7_WLJ"
        help
          Support for the HTC APQ8064 M7_WLJ.

config MACH_M7_DCG
        depends on ARCH_APQ8064
        bool "APQ8064 M7_DCG"
        help
          Support for the HTC APQ8064 M7_DCG.

config MACH_M7_DUG
        depends on ARCH_APQ8064
        bool "APQ8064 M7_DUG"
        help
          Support for the HTC APQ8064 M7_DUG.

config MACH_M7_DTU
        depends on ARCH_APQ8064
        bool "APQ8064 M7_DTU"
        help
          Support for the HTC APQ8064 M7_DTU.

config MACH_M7C_DTU
        depends on ARCH_APQ8064
        bool "APQ8064 M7C_DTU"
        help
          Support for the HTC APQ8064 M7C_DTU.

config MACH_M7C_DUG
        depends on ARCH_APQ8064
        bool "APQ8064 M7C_DUG"
        help
          Support for the HTC APQ8064 M7C_DUG.

config MACH_M7C_DWG
        depends on ARCH_APQ8064
        bool "APQ8064 M7C_DWG"
        help
          Support for the HTC APQ8064 M7C_DWG.

config MACH_M7_EVM
        depends on ARCH_APQ8064
        bool "APQ8064 M7_EVM"
        help
          Support for the HTC APQ8064 M7_EVM.
```

## arch/arm/mach-msm/boards/board-monarudo/Kconfig
```kconfig
config MACH_MONARUDO
	depends on ARCH_APQ8064
	bool "MONARUDO"
	help
	  Support for the HTC Droid DNA
```

## arch/arm/mach-msm/boards/board-zara/Kconfig
```kconfig
config MACH_ZARA
	depends on ARCH_MSM8930
	bool "ZARA"
	help
	  Support for the HTC ZARA
```
